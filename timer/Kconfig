## timer/Kconfig
```kconfig
menuconfig TIMER
	bool "Timer Subsystem"
	depends on MACH_HAS_TIMER
	help
		Activate Timer Subsystem
	config TIMER_MULTI
		bool "Multiply Timerss"
		depends on TIMER
		help
			Multiply Timers
```

## uart/Kconfig
```kconfig
menuconfig UART
	bool "UART Subsystem"
	depends on MACH_HAS_UART || RPROC || ARCH_ARM
	help
		Activate UART Subsystem
	config UART_GENERIC_STRING
		bool "UART Generic String implementation"
		depends on UART
		help
			Some Devices can optimize the transfer of hohe Sting by buffer. This Option activate a software Variant without Buffering.
	config UART_GENERIC_BYTE
		bool "UART Generic Byte implementation"
		depends on UART
		help
			Some Devices can optimize the transfer of hohe Sting by buffer. This Option activate a software Variant without Buffering.
	config UART_THREAD_SAFE
		bool "UART is thread safe"
		depends on UART
		select USE_MUTEXES
		select USE_RECURSIVE_MUTEXES
		help
			Make UART thread safe
	config UART_MULTI
		bool "Multiply UARTs"
		depends on UART
		help
			Multiply UARTs
```
