## sensor/Kconfig
```kconfig
menuconfig SENSOR
	bool "Sensor Driver"
	default n
	help
		Sensor Driver
menuconfig ACCEL
	bool "Accelerator Subssystem"
	depends on SENSOR
	default n
	help
		Activate Accelerator Subssystem
	config ACCEL_THREAD_SAVE
		bool "Accelerator is Thread Save"
		depends on ACCEL
		select USE_MUTEXES
		select USE_RECURSIVE_MUTEXES
		default n
		help
			Make Accelerator Thread save
	config ACCEL_MULTI
		bool "Multiply Accelerators"
		depends on ACCEL
		default n
		help
			Multiply Accelerators
menuconfig GYRO
	bool "Gyro Subssystem"
	depends on SENSOR
	default n
	help
		Activate Gyroscope Subssystem
	config GYRO_THREAD_SAVE
		bool "Gyro is Thread Save"
		depends on GYRO
		select USE_MUTEXES
		select USE_RECURSIVE_MUTEXES
		default n
		help
			Make Gyroscope Thread save
	config GYRO_MULTI
		bool "Multiply Gyros"
		depends on GYRO
		default n
		help
			Multiply Gyros

menuconfig TEMP
	bool "Temperature Sensor Subssystem"
	depends on SENSOR
	default n
	help
		Activate Temperature Subssystem
	config TEMP_THREAD_SAVE
		bool "Temperature Sensor is Thread Save"
		depends on TEMP
		select USE_MUTEXES
		select USE_RECURSIVE_MUTEXES
		default n
		help
			Make Temperature Sensor Thread save
	config TEMP_MULTI
		bool "Multiply Temperature Sensor"
		depends on TEMP
		default n
		help
			Multiply Temperature Sensor
	config TEMP_NTC
		bool "NTC Temperature Sensor Driver"
		depends on TEMP
		depends on ADC
		default n
		help
			NTC Temperature Sensor Driver need ADC

config INVIMU
	bool "Invensense IMU"
	depends on SENSOR
	depends on MACH_HAS_SPI
	select USE_MUTEXES
	select USE_RECURSIVE_MUTEXES
	select ACCEL
	select GYRO
	select SPI
	default n
	help
		MPU-9250 Driver
if INVIMU = y
	choice
		prompt "Select Device"
		config MPU9250
			bool "MPU-9250"
		config ICM20948
			bool "ICM-20948"
	endchoice

	config MPU9250_DEBUG
		bool "MPU Debug"
		default n
endif

config LTC6811
	bool "LTC6811"
	depends on ADC
	depends on SPI
	depends on SENSOR
	select USE_MUTEXES
	select USE_RECURSIVE_MUTEXES
if LTC6811
	config LTC6811_DEBUG
		bool "LTC6811 Debug"
	config LTC6811_PRIO
		int "LTC6811 ADC Task Prio"
		default 2
	choice
		prompt "Select Conversion Time"
		config LTC6811_CONVERSION_HZ_7kHz
			bool "7kHz (2.3ms)"
		config LTC6811_CONVERSION_HZ_27kHz
			bool "27kHz (1.1ms)"
		config LTC6811_CONVERSION_HZ_14kHz
			bool "15kHz (1.3ms)"
		config LTC6811_CONVERSION_HZ_3kHz
			bool "3kHz (3.0ms)"
		config LTC6811_CONVERSION_HZ_2kHz
			bool "2kHz (4.4ms)"
		config LTC6811_CONVERSION_HZ_1kHz
			bool "1kHz (7.2ms)"
		config LTC6811_CONVERSION_HZ_422Hz
			bool "422Hz (12.8ms)"
		config LTC6811_CONVERSION_HZ_26Hz
			bool "26Hz (201ms)"
	endchoice
	config LTC6811_FREQ_MS
		int "ADC Period (in ms)"
		default 100
endif
```

## spi/Kconfig
```kconfig
menuconfig SPI
	bool "SPI Subsystem"
	depends on MACH_HAS_SPI
	help
		Activate SPI Subsystem
	config SPI_THREAD_SAFE
		bool "SPI is thread safe"
		depends on SPI
		select USE_MUTEXES
		select USE_RECURSIVE_MUTEXES
		help
			Make SPI thread safe
	config SPI_MULTI
		bool "Multiply SPIs"
		depends on SPI
		help
			Multiply SPIs
```
