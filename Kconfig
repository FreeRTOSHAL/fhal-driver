## Kconfig
```kconfig
menu "Driver"
menu "Generic Driver Settings"
	config INSTANCE_NAME
		bool "Instance Name Support"
		default n
		help
			Support Print Instance Name. Each Driver Add a Uniqe Instance Name. 
	config USE_STATIC
		bool "Use FreeRTOS Static Function"
		depends on SUPPORT_STATIC_ALLOCATION
		default y
	config GEN_VERSION
		bool "Generated Version"
		default n
		help
			Generated Version Strings for all Subssystems
			
			Strings are defined in hal.h

			versionDriver: Driver git Version
			versionMach: Mach git Version
			versionArch: Arch git Version
			versionKernel: Kernel git Version

endmenu
source driver/gcc/Kconfig
source driver/gpio/Kconfig
source driver/uart/Kconfig
source driver/newlib/Kconfig
source driver/buffer/Kconfig
source driver/spi/Kconfig
source driver/sensor/Kconfig
source driver/adc/Kconfig
source driver/power/Kconfig
source driver/timer/Kconfig
source driver/pwm/Kconfig
source driver/capture/Kconfig
source driver/example/Kconfig
source driver/nlibc/Kconfig
source driver/sd/Kconfig
source driver/mailbox/Kconfig
source driver/remoteproc/Kconfig
source driver/net/Kconfig
source driver/counter/Kconfig
source driver/rtc/Kconfig
source driver/can/Kconfig
source driver/i2c/Kconfig
config CACHE
	bool
	help
		Cache Subsystem Support
endmenu
```

## adc/Kconfig
```kconfig
menuconfig ADC
	bool "ADC Subsystem"
	help
		Activate ADC Subsystem
	config ADC_THREAD_SAVE
		bool "ADC is Therad Save"
		depends on ADC
		select USE_MUTEXES
		select USE_RECURSIVE_MUTEXES
		help
			Make ADC Thread save
	config ADC_MULTI
		bool "Multiply ADCs"
		depends on ADC
		help
			Multiply ADCs
	config ADCS747X
		bool "TI ADCS747x Driver"
		depends on SPI
		depends on ADC
		help 
			TI ACSS747x Driver connected with spi
		config ADCS747X_PRIO
			int "ADCS747x Thread Prio"
			depends on ADCS747X
			default 4
			help
				ADCS747X Support Callback by FreeRTOS Thread
				On HW this is ISR Callback
	config MCP320X
		bool "TI MCP320X Driver"
		depends on SPI
		depends on ADC
		help 
			TI ACSS747x Driver connected with spi
		config MCP320X_PRIO
			int "MCP320X Thread Prio"
			depends on MCP320X
			default 4
			help
				MCP320X Support Callback by FreeRTOS Thread
				On HW this is ISR Callback
		config MCP320X_DEBUG
			bool "MCP320X Debug printf"
			depends on MCP320X
			default n
	config ADC_TEST
		bool "ADC Test Driver"
		default n
		depends on ADC
		help
			ADC Test Driver
		config ADC_TEST_PRIO
			int "ADC Test Thread Prio"
			depends on ADC_TEST
			default 4
			help
				ADC Test Support Callback by FreeRTOS Thread
				On HW this is ISR Callback
```

## buffer/Kconfig
```kconfig
config BUFFER
	bool "Shared Memmory for heterogeneous Multicore Possessor"
	depends on MACH_HAS_BUFFER
	help
		Shared Memmory for heterogeneous Multicore Possessor
	
```

## can/Kconfig
```kconfig
menuconfig CAN
	bool "CAN Subsystem"
	depends on MACH_HAS_CAN 
	help
		Activate CAN Subsystem
	config CAN_THREAD_SAFE
		bool "CAN is thread safe"
		depends on CAN
		select USE_MUTEXES
		select USE_RECURSIVE_MUTEXES
		help
			Make CAN thread safe
	config CAN_FD
		bool "Activate CAN FD Support"
		depends on CAN
	config CAN_MULTI
		bool "Multiply CAN"
		depends on CAN
		help
			Multiply CAN Driver
```

## capture/Kconfig
```kconfig
menuconfig CAPTURE
	bool "Capture Subsystem"
	depends on MACH_HAS_CAPTURE || RTC
	help
		Activate Capture Subsystem
	config CAPTURE_MULTI
		bool "Multiply Captures"
		depends on CAPTURE
		help
			Multiply Captures
	config CAPTURE_SOFTWARE
		bool "Softawre Capture use RTC"
		depends on CAPTURE
		depends on RTC
		default n
		help
			Software Capture use RTC
```

## counter/Kconfig
```kconfig
menuconfig COUNTER
	bool "Counter Subsystem"
	help
		Activate Hartware Counter Subsystem
	config COUNTER_THREAD_SAVE
		bool "Counter is Thread Save"
		depends on COUNTER
		select USE_MUTEXES
		select USE_RECURSIVE_MUTEXES
		help
			Make Counter Thread save
	config COUNTER_MULTI
		bool "Multiply Counter driver"
		depends on COUNTER
		help
			Multiply Counter driver
	config COUNTER_SOFTWARE
		bool "GPIO Based Counter"
		depends on COUNTER
		depends on GPIO
		config COUNTER_SOFTWARE_DEBUG
			bool "Debug GPIO Based Counter"
			depends on COUNTER_SOFTWARE
```

## dac/Kconfig
```kconfig
menuconfig DAC
	bool "DAC Subsystem"
	help
		Activate DAC Subsystem
	config DAC_THREAD_SAVE
		bool "DAC is Thread Save"
		depends on DAC
		select USE_MUTEXES
		select USE_RECURSIVE_MUTEXES
		help
			Make DAC Thread save
	config DAC_MULTI
		bool "Multiple DACs"
		depends on DAC
		help
			Multiple DACs
	config MCP492X
		bool "TI MCP492X Driver"
		depends on SPI
		depends on DAC
		help 
			TI MCP492X Driver connected with spi
		config MCP492X_DEBUG
			bool "MCP492X Debug printf"
			depends on MCP492X
			default n
```

## example/Kconfig
```kconfig
menuconfig EXAMPLE
	bool "Example Subsystem"
	help
		Activate Example Subsystem

		This Subsystem is only a demonstration of driver system 
	config EXAMPLE_MULTI
		bool "Multiply Example driver"
		depends on EXAMPLE
		help
			Multiply Example driver
	config EXAMPLE_THREAD_SAFE
		bool "Example is thread safe"
		depends on EXAMPLE
		select USE_MUTEXES
		select USE_RECURSIVE_MUTEXES
		default n
		help
			Make Example thread safe
	config EXAMPLE_DEV0
		bool "Example Driver 0"
		depends on EXAMPLE
		help
			Example driver Dev 0
	config EXAMPLE_DEV1
		bool "Example Driver 1"
		depends on EXAMPLE
		help
			Example driver Dev 1
```

## gcc/Kconfig
```kconfig
menuconfig GCC
	bool "GCC Tools"
if GCC
	config GCC_BACKTRACE
		bool "Unwind Backtrace"
		depends on DEBUG
		depends on ARCH_SUPPORT_UNWIND_TABLES
		depends on ARCH_SUPPORT_CUSTOM_TASK_RETURN_ADDRESS
		select GENERATE_UNWIND_TABLES
endif
```

## gpio/Kconfig
```kconfig
menuconfig GPIO 
	bool "GPIO subsystem"
	depends on MACH_HAS_GPIO
	help
		Activate GPIO Subsystem
	config GPIO_MULTI
		bool "Multiple GPIO Drivers"
		depends on GPIO
		help
			Multiple GPIOs Driver Mode
```

## i2c/Kconfig
```kconfig
menuconfig I2C
	bool "I2C Subsystem"
	help
		Activate I2C Subsystem
	config I2C_THREAD_SAFE
		bool "I2C is thread safe"
		depends on I2C
		select USE_MUTEXES
		select USE_RECURSIVE_MUTEXES
		help
			Make I2C thread safe
	config I2C_MULTI
		bool "Multiply I2C"
		depends on I2C
		help
			Multiply I2C Driver
```

## mailbox/Kconfig
```kconfig
menuconfig MAILBOX
	bool "Mailbox Subsystem"
	depends on MACH_HAS_MAILBOX
	help
		Activate Mailbox Subsystem
	config MAILBOX_MULTI
		bool "Multiply Example driver"
		depends on MAILBOX
		help
			Multiply Mailbox driver
	config MAILBOX_THREAD_SAFE
		bool "Mailbox is thread safe"
		depends on MAILBOX
		select USE_MUTEXES
		select USE_RECURSIVE_MUTEXES
		default n
		help
			Make Mailbox thread safe
```

## net/Kconfig
```kconfig
menuconfig NET
	bool "Net Subsystem"
	depends on MACH_HAS_NET
	help
		Net Subsystem
	config NET_MULTI
		bool "Multiply Net driver"
		depends on NET
		help
			Multiply Net driver
	config NET_THREAD_SAFE
		bool "Net is thread safe"
		depends on NET
		select USE_MUTEXES
		select USE_RECURSIVE_MUTEXES
		default n
		help
			Make Net thread safe
	config NET_DUMMY
		bool "Net Dummy Driver"
		depends on NET
		default n
		help
			Net Dummy Driver
	config NET_VLAN
		bool "Net VLAN Driver"
		depends on NET
		default n
		help
			Net VLAN Driver
		config VLAN_MAX
			int "MAX VLANs"
			depends on NET_VLAN
			default 2
			help
				Max VLAN pre Instance
	config NET_PTP
		bool "PTP Net Driver"
		depends on NET
		default n
		help
			PTP Net Driver
if NET=y
	config MAC
		bool "Mac Subsystem"
		depends on MACH_HAS_MAC
		help
			Mac Subsystem
	source driver/net/phy/Kconfig
	source driver/net/lwip/Kconfig
endif
```

## net/lwip/Kconfig
```kconfig
menuconfig LWIP
	bool "LWIP Net Layer"
	select USE_MUTEXES
	select USE_COUNTING_SEMAPHORES
	depends on SUPPORT_DYNAMIC_ALLOCATION
if LWIP = y
	source driver/net/lwip/Kconfig.opt
	config LWIP_MEM
		bool
		depends on (MEM_DEFAULT || MEM_LIBC_MALLOC || MEM_USE_POOLS)
		default y
	config LWIP_PPP
		bool "PPP Support"
		default n
	config LWIP_HTTP
		bool "HTTP Support"
		default n
	config LWIP_IPERF
		bool "IPERF Support"
		default n
	config LWIP_SNTP
		bool "SNTP Support"
		default n
	config LWIP_NETBIOS
		bool "Netbios Support"
		default n
endif
```

## net/phy/Kconfig
```kconfig
menuconfig PHYLIB
	bool "Phylib"
	select MAC
	help
		Phy Lib based on Linux Kernel Phy Lib
		Generic Phy included
	config PHY_TASK_PRIO
		int "Task Prio"
		default 4
	config PHY_AT803X
		bool "Atheros 803X ethernet phys"
		depends on PHYLIB
```

## newlib/Kconfig
```kconfig
menuconfig NEWLIB
	bool "Use Newlib"
	depends on MACH_HAS_NEWLIB
	help
		Activate Newlib Interface. (Use of printf...)
config NEWLIB_UART
	bool "Use stdio, stdin and stdout"
	depends on NEWLIB
	depends on UART
	select NEWLIB_MALLOC
	default n
	help
		Activate Use of printf and scanf..
	config NEWLIB_UART_NEWLINE
	       bool "Replace \n to \r\n. Needed for minicom, putty,..."
	       depends on NEWLIB
	       depends on NEWLIB_UART
	       default y
	       help
		       The most UART Programms use \r\n as new line. 
		       The Api Replace the \n aganst \r\n
	config NEWLIB_USE_PUTS
		bool "Use puts in _write"
		depends on NEWLIB_UART
		default n
		help
			Use uart_puts instat of uart_putc
config NEWLIB_MALLOC
	bool "Use Malloc"
	depends on NEWLIB
	default n
	help
		Use Newlib malloc. Is Needed by printf etc...
	config NEWLIB_MALLOC_THREAD_SAFE
		bool "Make malloc Thread Safe"
		depends on NEWLIB
		depends on NEWLIB_MALLOC
		select USE_MUTEXES
		select USE_RECURSIVE_MUTEXES
		help
			Add Locking to Malloc
	choice
		prompt "sbrk Strategy"
		depends on NEWLIB
		depends on NEWLIB_MALLOC
		config MALLOC_1
			bool "Use FreeRTOS malloc function"
			depends on !HEAP_3
			help
				Use FreeROTS Heap Space. Use This only small space is alloc by malloc!
		config MALLOC_2
			bool "Array Base Alloc"
			help
				A global Array used by sbrk to alloc memory space
		config MALLOC_3
			bool "Linker File Base Alloc"
			depends on MACH_DEFINE_HEAP
			help
				The empty space between Data Section and Stack is used as Heap.
				The Linker File must provide to the Variable _Heap_end. 
	endchoice
	config NEWLIB_TOTAL_HEAP_SIZE
		int "Total Heap Size"
		depends on NEWLIB
		depends on MALLOC_2
		default 16384
		help
			Total Heap Size
```

## nlibc/Kconfig
```kconfig
menuconfig NLIBC
	bool "Use Nano Libc (no extern lib needed)"
	help
		Use Nano Libc (is in Conflicted with Newlib or other libc implementation)
config NLIBC_PRINTF
	bool "printf, sprintf, snprintf"
	depends on NLIBC
	default n
	help
		Activate Support for printf, sprintf, snprintf, ... (Without Floating Point Support) 
config NLIBC_PRINTF_NEWLINE
	bool "Replace \n to \r\n. Needed for minicom, putty,..."
	depends on NLIBC
	depends on NLIBC_PRINTF
	default y
	help
		The most UART Programms use \r\n as new line. 
		The Api Replace the \n aganst \r\n
config NLIBC_MEMCPY 
	bool "memcpy"
	depends on NLIBC
	default y
	help
		Add Support for memcpy
config NLIBC_MEMSET
	bool "memset"
	depends on NLIBC
	default y
	help
		Add Support for memset
config NLIBC_STRING
	bool "strlen, strcpy, strncpy, ..."
	depends on NLIBC
	default n
	help
		Add Support for strlen, strcpy, strncpy, ...
		
```

## power/Kconfig
```kconfig
menuconfig POWER
	bool "Power Supply Driver"
	config TPS65381
		bool "TPS65381"
		depends on POWER
		depends on MACH_HAS_SPI
		depends on MACH_HAS_ADC
		select SPI
		select ADC
		help
			TPS65381 Driver
```

## pwm/Kconfig
```kconfig
menuconfig PWM
	bool "PWM Subsystem"
	depends on MACH_HAS_PWM || MACH_HAS_TIMER
	help
		Activate PWM Subsystem
	config PWM_MULTI
		bool "Multiply PWMs"
		depends on PWM
		help
			Multiply PWMs
	config PWM_SOFTWARE
		bool "Software PWM"
		depends on PWM
		depends on TIMER
		help
			Software PWM based on GPIO and a HW Timter
		config PWM_SOFTWARE_DEBUG
			bool "Debug Mode"
			depends on PWM_SOFTWARE
	config TLC5947
		bool "TLC5947 LED Driver"
		depends on PWM
		depends on GPIO
		help
			TLC5947 LED Driver
```

## remoteproc/Kconfig
```kconfig
menuconfig RPROC
	bool "Remoteproc (Linux AMP Subsystem)"
	help
		Linux Remoteproc Support
if RPROC=y
	config RPROC_MAILBOX
		bool "Remoteproc over Mailbox"
	config RPROC_MAILBOX_PRIO
		int "Remoteproc Mailbox Task Prio"
		depends on RPROC_MAILBOX
		default 4
	config RPROC_TRACE
		bool "Remoteproc Trace Support"
		depends on UART
		default n
endif
```

## rtc/Kconfig
```kconfig
menuconfig RTC
	bool "RTC Subsystem"
	depends on MACH_HAS_RTC || TIMER
	help
		Activate RTC Subsystem
	config RTC_MULTI
		bool "Multiply RTC driver"
		depends on RTC
		help
			Multiply RTC driver
	config RTC_THREAD_SAVE
		bool "RTC is Thread Save"
		depends on RTC
		select USE_MUTEXES
		select USE_RECURSIVE_MUTEXES
		default n
		help
			Make RTC Thread save
	config RTC_SOFTWARE
		bool "Software RTC base on HW Timer"
		depends on RTC
		depends on TIMER
		default n
		help
			Software RTC build with HW Timer
```

## sd/Kconfig
```kconfig
menuconfig SD
	bool "SD / SDIO Subsystem"
	depends on MACH_HAS_SD || MACH_HAS_SDIO 
	help
		Activate SD / SDIO Subsystem
	config SD_MULTI
		bool "Multiply SD driver"
		depends on SD
		help
			Multiply SD / SDIO driver
	config SD_THREAD_SAFE
		bool "SD is thread safe"
		depends on SD
		select USE_MUTEXES
		select USE_RECURSIVE_MUTEXES
		default n
		help
			Make SD thread safe
```
